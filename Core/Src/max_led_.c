/*
 * File:   main.c
 * Author: boos
 *
 * Created on 17. September 2021, 03:49
 */

// CONFIG1
// #pragma config FOSC = INTOSC    // Oscillator Selection Bits (INTOSC oscillator: I/O function on CLKIN pin)
// #pragma config WDTE = OFF       // Watchdog Timer Enable (WDT disabled)
// #pragma config PWRTE = OFF      // Power-up Timer Enable (PWRT disabled)
// #pragma config MCLRE = OFF      // MCLR Pin Function Select (MCLR/VPP pin function is digital input)
// #pragma config CP = OFF         // Flash Program Memory Code Protection (Program memory code protection is disabled)
// #pragma config BOREN = OFF      // Brown-out Reset Enable (Brown-out Reset disabled)
// #pragma config CLKOUTEN = OFF   // Clock Out Enable (CLKOUT function is disabled. I/O or oscillator function on the CLKOUT pin)
// #pragma config IESO = OFF       // Internal/External Switchover Mode (Internal/External Switchover Mode is disabled)
// #pragma config FCMEN = OFF      // Fail-Safe Clock Monitor Enable (Fail-Safe Clock Monitor is disabled)

// // CONFIG2
// #pragma config WRT = OFF        // Flash Memory Self-Write Protection (Write protection off)
// #pragma config CPUDIV = CLKDIV6 // CPU System Clock Selection Bit (CPU system clock divided by 6)
// #pragma config USBLSCLK = 48MHz // USB Low SPeed Clock Selection bit (System clock expects 48 MHz, FS/LS USB CLKENs divide-by is set to 8.)
// #pragma config PLLMULT = 3x     // PLL Multipler Selection Bit (3x Output Frequency Selected)
// #pragma config PLLEN = ENABLED  // PLL Enable Bit (3x or 4x PLL Enabled)
// #pragma config STVREN = ON      // Stack Overflow/Underflow Reset Enable (Stack Overflow or Underflow will cause a Reset)
// #pragma config BORV = LO        // Brown-out Reset Voltage Selection (Brown-out Reset Voltage (Vbor), low trip point selected.)
// #pragma config LPBOR = OFF      // Low-Power Brown Out Reset (Low-Power BOR is disabled)
// #pragma config LVP = OFF        // Low-Voltage Programming Enable (High-voltage on MCLR/VPP must be used for programming)

// #include <xc.h>



#include "main.h"

// main function
uint8_t disp1ay[38][8]={
{0x3C,0x42,0x42,0x42,0x42,0x42,0x42,0x3C},//0
{0x10,0x30,0x50,0x10,0x10,0x10,0x10,0x7c},//1
{0x7E,0x2,0x2,0x7E,0x40,0x40,0x40,0x7E},//2
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{0x0,0x7F,0x2,0x4,0x8,0x10,0x20,0x7F},//Z
};

void write_byte (uint8_t byte)
{
	for (int i =0; i<8; i++)
	{
		HAL_GPIO_WritePin (GPIOA, GPIO_PIN_4, 0);  // pull the clock pin low
		HAL_GPIO_WritePin (GPIOA, GPIO_PIN_7, byte&0x80);  // write the MSB bit to the data pin
		byte = byte<<1;  // shift left
		HAL_GPIO_WritePin (GPIOA, GPIO_PIN_4, 1);  // pull the clock pin HIGH
	}
}

void write_max (uint8_t address, uint8_t data)
{
	HAL_GPIO_WritePin (GPIOA, GPIO_PIN_6, 0);  // pull the CS pin LOW
	write_byte (address);
	write_byte (data); 
	HAL_GPIO_WritePin (GPIOA, GPIO_PIN_6, 1);  // pull the CS pin HIGH
}

void max_init(void)
{
 write_max(0x09, 0x00);       //  no decoding
 write_max(0x0a, 0x03);       //  brightness intensity
 write_max(0x0b, 0x07);       //  scan limit = 8 LEDs
 write_max(0x0c, 0x01);       //  power down =0,normal mode = 1
 write_max(0x0f, 0x00);       //  no test display
}

void write_string (char *str)
{
	while (*str)
	{
		for(int i=1;i<9;i++)
			   {
			       write_max (i,disp1ay[(*str - 55)][i-1]);
			   }
		*str++;
		HAL_Delay (500);
	}
}

